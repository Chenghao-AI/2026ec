//-----------------------------------------------------------------------------
// 头文件包含
//-----------------------------------------------------------------------------
#include <LCD1602.h>


//-----------------------------------------------------------------
// 初始化程序区
//-----------------------------------------------------------------

//-----------------------------------------------------------------
// void LCD_Init (void)
//-----------------------------------------------------------------
//
// 函数功能: LCM初始化
// 入口参数: 无
// 返回参数: 无
// 全局变量: 无   
// 注意事项: 
//     (1)具体流程查看HD44780(KS0066)的中文数据手册;
//-----------------------------------------------------------------
void LCD_Init()
{
	lcden=0;
	LCDWrite_com(0x38);
	LCDWrite_com(0x0c);
	LCDWrite_com(0x06);
	LCDWrite_com(0x01);
	LCDWrite_com(0x80);	  //设置1602指针为第一行第一个
}


//-----------------------------------------------------------------
// 功能程序区
//-----------------------------------------------------------------

//-----------------------------------------------------------------------------
// void Delay_ms(uint z)
//-----------------------------------------------------------------------------
//
// 函数功能: 时基为1ms的延时
// 例子提示: 调用Delay_ms(20),得到20ms延时
// 入口参数: 无符号8bit整数
// 返回参数: 无
// 全局变量: 无
// 注意事项: 基于使用11.0592MHz晶振的51单片机
//-----------------------------------------------------------------------------
void Delay_ms(uint z)
{
	uint x,y;
	for(x=z;x>0;x--)
		for(y=110;y>0;y--);
}


//-----------------------------------------------------------------
// void LCDWrite_com(uchar com)
//-----------------------------------------------------------------
//
// 函数功能: 写LCD的指令代码
// 入口参数: LCD指令
// 返回参数: 无
// 全局变量: 无   
// 注意事项:
//-----------------------------------------------------------------             
void LCDWrite_com(uchar com)
{
	lcdrs=0;
	lcdrw=0;
	lcddat=com;
	Delay_ms(5);
	lcden=1;
	Delay_ms(5);
	lcden=0;
}



//-----------------------------------------------------------------
// void LCDWrite_data(uchar date)
//-----------------------------------------------------------------
//
// 函数功能: 写LCD要显示的数据
// 入口参数: 待写的数据
// 返回参数: 无
// 全局变量: 无     
// 注意事项:
//-----------------------------------------------------------------
void LCDWrite_data(uchar date)
{	
	lcdrs=1;
	lcdrw=0;
	lcddat=date;
	Delay_ms(5);
	lcden=1;
	Delay_ms(5);
	lcden=0;
}
void LCDWrite_word(unsigned char *s)
{
	while(*s>0)
	{
		LCDWrite_data(*s);
		s++;
	}
}
void LCD_Play(uchar add,uint dat)
{
	uchar i;
	uchar wei[6];
	wei[0] = (dat/10000%10)+48;	
	wei[1] = (dat/1000%10)+48;			//千
	wei[2] = (dat/100%10)+48;			//百
	wei[3] = (dat/10%10)+48;				//十
	wei[4] ='.'	;
	wei[5] = (dat%10)+48;					//个
	LCDWrite_com(0x80+add);
	for(i=0; i<6; i++)
	{
		LCDWrite_data(wei[i]);
	}

}
//-----------------------------------------------------------------------------
// End Of File
//-----------------------------------------------------------------------------