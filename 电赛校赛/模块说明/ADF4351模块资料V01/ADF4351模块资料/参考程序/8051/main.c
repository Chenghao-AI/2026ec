//-----------------------------------------------------------------
// 程序描述：
//     adf4351 PLL锁相环 输出频率控制主程序
// 作    者: 凌智电子
// 开始日期: 2019-07-1
// 完成日期: 2019-07-1
// 修改日期:
// 版    本: V1.0 
// 调试工具: 51单片机电子系统开发板;	   	adf4351 PLL锁相环模块；
//					 1602字符型液晶显示模块(LCM)；键盘模块
// 说    明: (1) 采用LCD1602显示输出频率
//    			 (2)'K1'键    ：进入变频率的操作
//    			 (3)'K2'键    ：频率加一
//    			 (4)'K3'键    ：频率减一
//				   (5)'K4'键    ：退出改变频率
//           (6)调试使用的系统时钟频率Fsysclk=11.0592MHz.
//           (7)硬件连接：
//							CLK  ->  P1.7
//							DATA ->  P1.6	
//							LE   ->  P1.5	
//							CE   ->  P1.4
//				 (8)设置频率超过模块实际最大输出频率时，设置无效，任然输出模块最大频率	
//-----------------------------------------------------------------



//-----------------------------------------------------------------
// 头文件包含
//-----------------------------------------------------------------
#include <reg52.h>
#include <intrins.h>
#include "LCD1602.h"
#include "adf4351.h"
#include "delay.h"
//-----------------------------------------------------------------------------
// 宏定义
//-----------------------------------------------------------------------------
#define uchar unsigned char
#define uint unsigned int
#define ulint unsigned long int
//-----------------------------------------------------------------------------
// 函数声明
//-----------------------------------------------------------------------------
void KEY();
//-----------------------------------------------------------------------------
// 变量声明
//-----------------------------------------------------------------------------
ulint F;       // 频率值
uint fs;       // 频率值缓存
uchar j=8;
bit k;         // 按键标志位
sbit k1=P3^2;  // 进入变频率的操作		
sbit k2=P3^3;  // 频率加一
sbit k3=P3^4;  // 频率减一
sbit k4=P3^5;  // 退出变频率的操作
//-----------------------------------------------------------------------------
// 主函数
//-----------------------------------------------------------------------------
void main()
{	 
	F =350;   // F为频率值的十倍（MHz）
	LCD_Init();			// 液晶初始化
	ADF4351_Init(F);    // 起始频率设置为35M
	//显示
	LCDWrite_word("THE Fout IS :");	
	LCD_Play(0x42,F);
	LCDWrite_com(0x80+0x48);
	LCDWrite_word("MHz");
	//显示	
	while(1) 
	{
		KEY();		 // 检测是否有按键按下
		if(k)       // 有按键按下，改变频率
		{
			k = 0;	 			
			if (F>=690&&F<=1370)	 ADF4351_Wdata(0x0050443c);  // if,else if中得语句是判断此时频率得范围		  
	 		else if (F>1370&&F<=2740) ADF4351_Wdata(0x0040443c); // 根据频率的范围确定我们要更新此时寄存器4的值
			else if (F>2740&&F<=5490) ADF4351_Wdata(0x0030143c);
			else if (F>5490&&F<=10990) ADF4351_Wdata(0x0020143c); 
			else if (F>10990&&F<=21990) ADF4351_Wdata(0x0010143c); 
     	 	else if (F>21990)  ADF4351_Wdata(0x0000143c); 
			else ADF4351_Wdata(0x0060a43c);	
														        	
			LCD_Play(0x42,F);						// 显示此时的频率
			LCDWrite_com(0x80+0x40+j);
			ADF4351_Wdata(0x00000000|F<<15); 	   // 把要输出频率的字写入寄存器0，改变输出频率
		
		}
		
	}
	
}																				 


//-----------------------------------------------------------------
// 功能程序区
//-----------------------------------------------------------------

//-----------------------------------------------------------------
// void KEY()
//-----------------------------------------------------------------
//
// 函数功能: 键盘扫描
// 入口参数: 无
// 返回参数: 无
// 全局变量: 无    
// 注意事项: 
//-----------------------------------------------------------------
void KEY()
{
	if(!k1 || !k2 || !k3 || !k4)     // 有键按下
	{
		Delay_ms(20);
   // 选择频率变化位		
		if(!k1)                        
		{
			while(!k1);                  // 等待按键释放  
			j--;    //j=8	
			if(j==6)   j--;	             // 跳过“.”			
			if(j<2) j=7;                 // 从最低位重新开始
			LCDWrite_com(0x80+0x40+j);   // 选择写入地址
			LCDWrite_com(0x0d);	         // 开启光标    				
		}	
   // 频率对应位的数值加一		
		if(!k2)             
		{
			while(!k2);	                 // 等待按键释放 
			switch(j)
			{
				case 7:                    // 频率值加0.1MHz
					F+=1;
					break;                   
				case 5:                    // 频率值加1MHz
					F+=10;
				     break;
				case 4:                    // 频率值加10MHz
					F+=100;
				     break;
				case 3:                    // 频率值加100MHz
					F+=1000;
				     break;
				case 2:                    // 频率值加1000MHz
					F+=10000;
				     break;
				default:break;
               }
			if(F>=44000)   F=44000;      // ADF4351频率值上限为4.4GHz
			k = 1;		
		}
		// 频率对应位的数值加减一
		if(!k3)
		{
			while(!k3);	                 // 等待按键释放
			switch(j)
			{
				case 7:                    // 频率值减0.1MHz
					F-=1;
					break;
				case 5:                    // 频率值减1MHz
					F-=10;
				     break;
				case 4:                    // 频率值减10MHz
					F-=100;
				     break;
				case 3:                    // 频率值减100MHz
					fs=F/1000;
				  if(fs!=0)                // 频率值大于99MHz，允许频率值减少
					F-=1000;
				     break;
				case 2:                    // 频率值减1000MHz
					fs=F/10000;
				  if(fs!=0)					       // 频率值大于999MHz，允许频率值减少
					F-=10000;
				     break;
				default:break;
               }
			k = 1;
			if(F <350)                   // ADF4351频率值下限为35MHz
				F = 350;	
		}
	  // 退出变频操作
		if(!k4)
		{
			while(!k4);	
//			k = 1;
			LCDWrite_com(0x0c);	        // 关闭光标显示
               j=8;			
//			if(F < 350)
//				F = 350;	
		}
	}
}


//-----------------------------------------------------------------------------
// End Of File
//-----------------------------------------------------------------------------